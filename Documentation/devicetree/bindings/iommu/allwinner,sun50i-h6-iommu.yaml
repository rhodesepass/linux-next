## Documentation/devicetree/bindings/iommu/allwinner,sun50i-h6-iommu.yaml
```yaml
# SPDX-License-Identifier: (GPL-2.0 OR BSD-2-Clause)
%YAML 1.2
---
$id: http://devicetree.org/schemas/iommu/allwinner,sun50i-h6-iommu.yaml#
$schema: http://devicetree.org/meta-schemas/core.yaml#

title: Allwinner IOMMU

maintainers:
  - Chen-Yu Tsai <wens@csie.org>
  - Maxime Ripard <mripard@kernel.org>

description: |
  The Allwinner IOMMU provides address translation for various bus masters
  (display engine, video engine, camera, G2D, etc.).  The hardware exists in
  several generations that differ in the number of micro-TLBs and in the
  TLB / PTW-cache invalidation method.

  The four hardware generations are:

    V1 (sun50i-a63) — 6 micro-TLBs, address + mask invalidation.
        SoCs: A63, H6-class (BSP sun50iw3, sun50iw6).

    V2 (sun8i-a50) — 7 micro-TLBs, address + mask invalidation.
        SoCs: A50 / V831-class (BSP sun8iw15).

    V3 (sun50i-h616) — 7 micro-TLBs, range-based TLB invalidation,
        single-address PTW-cache invalidation.
        SoCs: H616, H618, T507-class (BSP sun50iw9, sun8iw19, sun50iw10).

    V4 (sun20i-d1) — 7 micro-TLBs, range-based TLB + PTW-cache
        invalidation with prefetch-valid fix.
        SoCs: D1, D1s, T113, R528-class (BSP sun8iw20, sun20iw1,
        sun50iw12, sun55iw3).

  On sun50iw10 (a V3-class SoC) a newer chip revision contains the
  prefetch-valid fix found in V4.  To indicate this, the optional boolean
  property "allwinner,sun50iw10-iommu-fixed" can be set.

properties:
  "#iommu-cells":
    const: 1
    description:
      The content of the cell is the master ID (micro-TLB index, 0-based).

  compatible:
    oneOf:
      - enum:
          - allwinner,sun50i-a63-iommu
          - allwinner,sun8i-a50-iommu
          - allwinner,sun50i-h616-iommu
          - allwinner,sun20i-d1-iommu
      - items:
          - const: allwinner,sun50i-h6-iommu
          - const: allwinner,sun50i-a63-iommu
      - items:
          - const: allwinner,sun55i-a523-iommu
          - const: allwinner,sun50i-h616-iommu
      - items:
          - const: allwinner,sun8i-t113-iommu
          - const: allwinner,sun20i-d1-iommu

  reg:
    maxItems: 1

  interrupts:
    maxItems: 1

  clocks:
    maxItems: 1

  resets:
    maxItems: 1

  allwinner,sun50iw10-iommu-fixed:
    type: boolean
    description: |
      Indicates that this is the newer revision of the sun50iw10 IOMMU which
      includes the prefetch-valid fix.  Only meaningful when compatible is
      "allwinner,sun50i-h616-iommu".  When set, the driver enables the
      prefetch-valid fix and uses an optimised TLB prefetch value.

required:
  - "#iommu-cells"
  - compatible
  - reg
  - interrupts
  - clocks
  - resets

additionalProperties: false

examples:
  - |
    #include <dt-bindings/interrupt-controller/arm-gic.h>
    #include <dt-bindings/interrupt-controller/irq.h>

    #include <dt-bindings/clock/sun50i-h6-ccu.h>
    #include <dt-bindings/reset/sun50i-h6-ccu.h>

    iommu: iommu@30f0000 {
        compatible = "allwinner,sun50i-a63-iommu";
        reg = <0x030f0000 0x10000>;
        interrupts = <GIC_SPI 57 IRQ_TYPE_LEVEL_HIGH>;
        clocks = <&ccu CLK_BUS_IOMMU>;
        resets = <&ccu RST_BUS_IOMMU>;
        #iommu-cells = <1>;
    };

  - |
    #include <dt-bindings/interrupt-controller/arm-gic.h>
    #include <dt-bindings/interrupt-controller/irq.h>

    #include <dt-bindings/clock/sun20i-d1-ccu.h>
    #include <dt-bindings/reset/sun20i-d1-ccu.h>

    iommu_d1: iommu@2010000 {
        compatible = "allwinner,sun20i-d1-iommu";
        reg = <0x02010000 0x10000>;
        interrupts = <GIC_SPI 64 IRQ_TYPE_LEVEL_HIGH>;
        clocks = <&ccu CLK_BUS_IOMMU>;
        resets = <&ccu RST_BUS_IOMMU>;
        #iommu-cells = <1>;
    };

...
```
